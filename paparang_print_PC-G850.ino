//
// #Sharp PC-G850 Pocket Computer SyncSerial Printer via M5 Stack
//
// ## BASIC COMMAND
// OPEN "LPRT:"
// LLIST
// (Sorry NO KANA FONT 0x80-)
//
// ## Connection
// M5 Stack (3.3V) <==> PC-G850 (5V)
// P2------+      (11pin I/F)
//     +-R-+-R--= 5 CLK
//     |
// G---+--------= 3 GND
//     |
//     +-R-+-R--= 7 DAT
// P5------+        
//
// Original Data and Sample Code :
// https://github.com/ihciah/miaomiaoji-tool
// https://lang-ship.com/blog/work/m5stickc-esp32-bluetooth-paperang///
//

#include "BluetoothSerial.h"
#include <M5Stack.h>
BluetoothSerial SerialBT;

// *** SET Your PAPERANG BT MAC ADDRESS ***
uint8_t address[6]  = {0x00, 0x15, 0x83, 0xB7, 0x27, 0x5E};

uint8_t img[256];
uint8_t msg[256];

/* FONT */
const unsigned char FONT[128][8] = {
/* 00-0F */
{0x00,0x00,0x00,0x00,0x00,0x00,0x00,0x00,},
{0x00,0x00,0x00,0x00,0x00,0x00,0x00,0x00,},
{0x00,0x00,0x00,0x00,0x00,0x00,0x00,0x00,},
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{0x00,0x00,0x00,0x00,0x00,0x00,0x00,0x00,},
/* 10-1F */
{0x00,0x00,0x00,0x00,0x00,0x00,0x00,0x00,},
{0x00,0x00,0x00,0x00,0x00,0x00,0x00,0x00,},
{0x00,0x00,0x00,0x00,0x00,0x00,0x00,0x00,},
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{0x00,0x00,0x00,0x00,0x00,0x00,0x00,0x00,},
/* 20-2F */
{0x00,0x00,0x00,0x00,0x00,0x00,0x00,0x00,},
{0x10,0x10,0x10,0x10,0x00,0x00,0x10,0x00,},
{0x28,0x28,0x28,0x00,0x00,0x00,0x00,0x00,},
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{0x00,0x04,0x08,0x10,0x20,0x40,0x00,0x00,},
/* 30-3F */
{0x38,0x44,0x4C,0x54,0x64,0x44,0x38,0x00,},
{0x10,0x30,0x10,0x10,0x10,0x10,0x38,0x00,},
{0x38,0x44,0x04,0x08,0x10,0x20,0x7C,0x00,},
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{0x38,0x44,0x04,0x08,0x10,0x00,0x10,0x00,},
/* 40-4F */
{0x38,0x44,0x04,0x34,0x54,0x54,0x38,0x00,},
{0x38,0x44,0x44,0x7C,0x44,0x44,0x44,0x00,},
{0x78,0x44,0x44,0x78,0x44,0x44,0x78,0x00,},
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{0x38,0x44,0x44,0x44,0x44,0x44,0x38,0x00,},
/* 50-5F */
{0x78,0x44,0x44,0x78,0x40,0x40,0x40,0x00,},
{0x38,0x44,0x44,0x44,0x54,0x48,0x34,0x00,},
{0x78,0x44,0x44,0x78,0x50,0x48,0x44,0x00,},
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{0x00,0x00,0x00,0x00,0x00,0x00,0x7C,0x00,},
/* 60-6F */
{0x30,0x20,0x10,0x00,0x00,0x00,0x00,0x00,},
{0x00,0x00,0x38,0x04,0x3C,0x44,0x3A,0x00,},
{0x40,0x40,0x58,0x64,0x44,0x44,0x78,0x00,},
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{0x00,0x00,0x38,0x44,0x44,0x44,0x38,0x00,},
/* 70-7F */
{0x00,0x00,0x78,0x44,0x44,0x78,0x40,0x40,},
{0x00,0x00,0x3C,0x44,0x44,0x3C,0x04,0x04,},
{0x00,0x00,0x58,0x64,0x40,0x40,0x40,0x00,},
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{0x00,0x00,0x00,0x00,0x00,0x00,0x00,0x00,},
};

static const unsigned int crc32tab[256] = {
  0x00000000, 0x77073096, 0xee0e612c, 0x990951ba,
  0x076dc419, 0x706af48f, 0xe963a535, 0x9e6495a3,
  0x0edb8832, 0x79dcb8a4, 0xe0d5e91e, 0x97d2d988,
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  0xb40bbe37, 0xc30c8ea1, 0x5a05df1b, 0x2d02ef8d,
};

unsigned int crc32(uint8_t *p, int len,unsigned int crcinit)
{
  unsigned int crc = 0;

  crc = crcinit ^ 0xFFFFFFFF;
  for (; len--; p++) {
    crc = ((crc >> 8) & 0x00FFFFFF) ^ crc32tab[(crc ^ (*p)) & 0xFF];
  }
  return crc ^ 0xFFFFFFFF;
}

/* ------------------------------------------ */

enum BtCommandByte {
  PRT_PRINT_DATA = 0,
  PRT_PRINT_DATA_COMPRESS = 1,
  PRT_FIRMWARE_DATA = 2,
  PRT_USB_UPDATE_FIRMWARE = 3,
  PRT_GET_VERSION = 4,
  PRT_SENT_VERSION = 5,
  PRT_GET_MODEL = 6,
  PRT_SENT_MODEL = 7,
  PRT_GET_BT_MAC = 8,
  PRT_SENT_BT_MAC = 9,
  PRT_GET_SN = 10,
  PRT_SENT_SN = 11,
  PRT_GET_STATUS = 12,
  PRT_SENT_STATUS = 13,
  PRT_GET_VOLTAGE = 14,
  PRT_SENT_VOLTAGE = 15,
  PRT_GET_BAT_STATUS = 16,
  PRT_SENT_BAT_STATUS = 17,
  PRT_GET_TEMP = 18,
  PRT_SENT_TEMP = 19,
  PRT_SET_FACTORY_STATUS = 20,
  PRT_GET_FACTORY_STATUS = 21,
  PRT_SENT_FACTORY_STATUS = 22,
  PRT_SENT_BT_STATUS = 23,
  PRT_SET_CRC_KEY = 24,
  PRT_SET_HEAT_DENSITY = 25,
  PRT_FEED_LINE = 26,
  PRT_PRINT_TEST_PAGE = 27,
  PRT_GET_HEAT_DENSITY = 28,
  PRT_SENT_HEAT_DENSITY = 29,
  PRT_SET_POWER_DOWN_TIME = 30,
  PRT_GET_POWER_DOWN_TIME = 31,
  PRT_SENT_POWER_DOWN_TIME = 32,
  PRT_FEED_TO_HEAD_LINE = 33,
  PRT_PRINT_DEFAULT_PARA = 34,
  PRT_GET_BOARD_VERSION = 35,
  PRT_SENT_BOARD_VERSION = 36,
  PRT_GET_HW_INFO = 37,
  PRT_SENT_HW_INFO = 38,
  PRT_SET_MAX_GAP_LENGTH = 39,
  PRT_GET_MAX_GAP_LENGTH = 40,
  PRT_SENT_MAX_GAP_LENGTH = 41,
  PRT_GET_PAPER_TYPE = 42,
  PRT_SENT_PAPER_TYPE = 43,
  PRT_SET_PAPER_TYPE = 44,
  PRT_GET_COUNTRY_NAME = 45,
  PRT_SENT_COUNTRY_NAME = 46,
  PRT_DISCONNECT_BT_CMD = 47,
  PRT_MAX_CMD = 48,
};

const unsigned int linelen = 48;
unsigned int doubleflag = 1;
const unsigned int standardKey = 0x35769521;
const unsigned int CRCKEY = (0x6968634 ^ 0x2e696d);
const unsigned int padding_line = 300;
const unsigned int max_send_msg_length = 2016;
const unsigned int max_recv_msg_length = 1024;
unsigned int linepadding = 8;

bool connected;

void packPerBytes(const void *bytes,uint16_t len,uint8_t control_command, uint8_t blockno,uint8_t *result,unsigned int crcinit=CRCKEY)
{
    result[ 0] = 0x02; // STX
    result[ 1] = control_command; // COMMAND
    result[ 2] = blockno; // Block
    result[ 3] = len & 0xFF; // Length(L)
    result[ 4] = (len >> 8) & 0xFF; // Length(H)
    uint8_t *src = (uint8_t *)bytes;
    uint8_t *dst = &result[5];
    for(int i=0;i<len;i++) {
      *dst++ = *src++ ;
    }
    unsigned int c = crc32(&result[5],len,crcinit);
    result[ 5+len] = c & 0xFF; // CRC32(0)
    result[ 6+len] = (c >> 8) & 0xFF;  // CRC32(1)
    result[ 7+len] = (c >> 16) & 0xFF;  // CRC32(2)
    result[ 8+len] = (c >> 24) & 0xFF;  // CRC32(3)
    result[ 9+len] = 0x03;
}

// Register CRC32 Key
void registerKey() {
  uint8_t key[4];
  unsigned int newkey = CRCKEY ^ standardKey;
  key[0] = newkey & 0xFF ;
  key[1] = (newkey >> 8) & 0xFF ;
  key[2] = (newkey >> 16) & 0xFF ;
  key[3] = (newkey >> 24) & 0xFF ;
  packPerBytes(key,4,PRT_SET_CRC_KEY,0,msg,standardKey);
  Serial.printf( "CRC32 Key write = %d\r\n", SerialBT.write(msg, 14) );
  //M5.Lcd.printf("CRC32 Key write.\n");
  //M5.Lcd.printf( "%02X,%02X,%02X,%02X,%02X,%02X,%02X,%02X,%02X,%02X,%02X,%02X,%02X,%02X\n",
  //msg[0],msg[1],msg[2],msg[3],msg[4],msg[5],msg[6],msg[7],msg[8],msg[9],msg[10],msg[11],msg[12],msg[13]);
}


uint32_t last,now;

void setup() {
  M5.begin();
  M5.Power.begin();
  M5.Lcd.setTextSize(2);
  M5.Lcd.fillScreen(BLACK);
  M5.Lcd.printf("Paperang Test\n");

  // Init
  SerialBT.begin("ESP32test", true);

  pinMode(2, INPUT);
  pinMode(5, INPUT);

  // Connect
  connected = SerialBT.connect(address);
  if (connected) {
    Serial.println("Connected Succesfully!\r\n");
    M5.Lcd.printf("Connected Succesfully!\n");
  } else {
    while (!SerialBT.connected(10000)) {
      Serial.println("Failed to connect. Make sure remote device is available and in range, then restart app.\r\n");
      M5.Lcd.printf("Failed to connect.\n");
    }
  }

  // registerKey (CONST)
  registerKey();

  now = last = micros();
  delay(100);
}

void feedLine(int i)
{
    img[0] = i & 0xFF;
    img[1] = (i >> 8) & 0xFF;
    packPerBytes((void *)img,2, PRT_FEED_LINE , 0 , msg);
    //Serial.printf( "Feed write = %d\r\n", SerialBT.write(msg, 12) );
    //M5.Lcd.printf( "Feed write (CRC) %02X,%02X,%02X,%02X.\n",msg[7],msg[8],msg[9],msg[10]);
    SerialBT.write(msg, 12);
}

const uint8_t bitdouble[16] =
{
  0b00000000,
  0b00000011,
  0b00001100,
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  0b11111111,
};

void printString(char *s)
{
  int slen   = strlen(s);
  int imglen = 48;
  for (int y=0;y<7;y++) {
    for (int i=0;i<imglen;i+=doubleflag) {
      if (i < slen*doubleflag) {
        if (doubleflag == 1) {
          img[i] = FONT[s[i]& 0x7F][y];
        } else {
          img[i+0] = bitdouble[(FONT[s[i>>1]& 0x7F][y] & 0xF0) >> 4];
          img[i+1] = bitdouble[FONT[s[i>>1]& 0x7F][y] & 0x0F];
        }
      } else {
        if (doubleflag == 1) {
          img[i] = 0x00;
        } else {
          img[i+0] = 0x00;
          img[i+1] = 0x00;
        }
      }
    }
    packPerBytes(img,imglen, PRT_PRINT_DATA , 0 , msg);
    /*
    Serial.printf( "Write Line = %d\r\n", SerialBT.write(msg, imglen+10) );
    Serial.printf( "Write Line = %d\r\n", SerialBT.write(msg, imglen+10) );
    */
    SerialBT.write(msg, imglen+10);
    SerialBT.write(msg, imglen+10);
  }
}

uint8_t  line[linelen+1];
uint8_t  linectr = 0;

uint8_t  data8 = 0;
uint8_t  lastsck = 0;
uint32_t ctr = 0;
uint32_t lineprintflag = 0;

void recvfrompc(uint8_t d8)
{
    //Serial.printf("%c",*d8);
    //M5.Lcd.printf("%02X,",*d8);
    if (d8 >= 0x20) {
        line[linectr++] = d8 ;
    }
    if ((linectr >= linelen/doubleflag) || (d8 == 0x0A)){
        line[linectr] = 0x00;
        lineprintflag = 1;
    }
}

void loop() {
  uint8_t  sck,si;

  M5.update();

  now = micros();
  si  = digitalRead(2);
  sck = digitalRead(5);
  if(lastsck != sck){
    if (sck != 0) { // Up Edge
        data8 = data8 << 1; // SHIFT IN from MSB
        data8 |= si ? 0x01 : 0x00 ;
        if (++ctr == 8) {
          recvfrompc(data8);
          ctr = 0;
          data8 = 0;
        }
    } else {
      if (now - last > 4000) { // Timeout
        data8 = 0;
        ctr = 0;
      }
    }
    last = now;
  }

  lastsck = sck;
  if ( M5.BtnA.wasPressed() ) {
    feedLine(44+linepadding);
  }

  if ( M5.BtnB.wasPressed() ) {
    feedLine(32*8);
  }

  if ( M5.BtnC.wasPressed() ) {
    printString("HELLO PAPERANG! HELLO PAPERANG! HELLO PAPERANG!");
    feedLine(linepadding);
  }

  if (lineprintflag) {
    lineprintflag = 0;
    linectr = 0;
    printString((char *)line);
    feedLine(linepadding);
  }

  /* USB UART SERIAL PRINT */
  if (Serial.available()) {
    /*SerialBT.write(Serial.read());*/
    uint8_t c = Serial.read();
    recvfrompc(c);
  }

  if (SerialBT.available()) {
    SerialBT.read();
  }
  //delay(20);
}
